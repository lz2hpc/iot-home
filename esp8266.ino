#include <ESP8266WiFi.h>
#include <PubSubClient.h>
//#include <Scheduler.h>
#include <TaskScheduler.h>
 
const char* ssid = "zzz";
const char* password =  "zzz";
const char* mqttServer = "zzz.zzz.zzz.zzz";
const int mqttPort = 11883;
const char* mqttUser = "zzz";
const char* mqttPassword = "zzz";

const char* CONNECTED = "[CONNECTED]";
const char* FAILED = "[FAILED]";

//this variable will hold a random number generated by the random() function
long randomNumber;
char msg[10];

Scheduler runner;
// Callback methods prototypes
void taskCallback();
// Tasks
// Adding task to the chain on creation
Task t(5000, TASK_FOREVER, &taskCallback, &runner, true);
 
WiFiClient espClient;
PubSubClient client(espClient);

void taskCallback()
{
   //generate a random number
  randomNumber = random(15,35);
  sprintf(msg, "%ld", randomNumber);
  client.publish("/esp/test", msg);
  Serial.println(msg);
  client.subscribe("/esp/test");
}

void setup() {
  Serial.begin(115200);
  connectWifi();
  connectBroker();
  runner.startNow(); // set point-in-time for scheduling start
}

void connectWifi() {  
  WiFi.begin(ssid, password); 
  Serial.println();
  Serial.println("CONNECTING TO WIFI...");
  while (WiFi.status() != WL_CONNECTED) {
    delay(5000);
    Serial.println(FAILED);
  }
  Serial.println(CONNECTED);
  Serial.print("IP: ");
  Serial.println(WiFi.localIP());
}
  
void connectBroker() {
  // init the broker
  client.setServer(mqttServer, mqttPort);
  client.setCallback(mqttCallback);
  while (!client.connected()) {
   Serial.println("CONNECTING TO MQTT...");
    if (client.connect("ESP8266Client", mqttUser, mqttPassword )) {
      Serial.println(CONNECTED);  
    } else {
    Serial.println(FAILED);
    Serial.print(client.state());
    delay(5000); 
  }
 } 
}
 
void mqttCallback(char* topic, byte* payload, unsigned int length) {
  Serial.print("TPC: ");
  Serial.println(topic);
  Serial.print("MSG: ");
  for (int i = 0; i < length; i++) {
    Serial.print((char)payload[i]);
  } 
  Serial.println();
  Serial.println("----------"); 
}
 
void loop() {
  client.loop();
  runner.execute();
}
